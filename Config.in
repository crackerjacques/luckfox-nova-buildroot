## configs/luckfox_nova_defconfig
```kconfig
# Luckfox Nova (RK3308B) - fully mainline stack, no vendor SDK.
# U-Boot 2025.04 (binman, rkbin TPL/BL31) + Linux 6.18.y + minimal rootfs.

BR2_aarch64=y
BR2_cortex_a35=y

# ftpmirror.gnu.org likes to redirect to dead mirrors - pin a reliable one
BR2_GNU_MIRROR="https://mirrors.kernel.org/gnu"

# Toolchain: ARM's prebuilt aarch64 toolchain (much faster than building one)
BR2_TOOLCHAIN_EXTERNAL=y
BR2_TOOLCHAIN_EXTERNAL_ARM_AARCH64=y

# System
BR2_TARGET_GENERIC_HOSTNAME="luckfox-nova"
BR2_TARGET_GENERIC_ISSUE="Welcome to Luckfox Nova (buildroot)"
BR2_TARGET_GENERIC_ROOT_PASSWD="nova"
BR2_SYSTEM_DHCP="eth0"
BR2_TARGET_GENERIC_GETTY_PORT="ttyS4"

# Kernel: latest 6.18.y stable; bump the value as point releases appear
BR2_LINUX_KERNEL=y
BR2_LINUX_KERNEL_CUSTOM_VERSION=y
BR2_LINUX_KERNEL_CUSTOM_VERSION_VALUE="6.18.8"
BR2_LINUX_KERNEL_PATCH="$(BR2_EXTERNAL_LUCKFOX_NOVA_PATH)/board/luckfox/nova/patches/linux"
# Proven config: same one Armbian's rockchip64-current kernel uses on this
# board (the arm64 defconfig + fragment combo produced timer-callback panics).
BR2_LINUX_KERNEL_USE_CUSTOM_CONFIG=y
BR2_LINUX_KERNEL_CUSTOM_CONFIG_FILE="$(BR2_EXTERNAL_LUCKFOX_NOVA_PATH)/board/luckfox/nova/linux.config"
BR2_LINUX_KERNEL_CONFIG_FRAGMENT_FILES="$(BR2_EXTERNAL_LUCKFOX_NOVA_PATH)/board/luckfox/nova/linux.fragment"
BR2_LINUX_KERNEL_DTS_SUPPORT=y
BR2_LINUX_KERNEL_INTREE_DTS_NAME="rockchip/rk3308-luckfox-nova"
BR2_LINUX_KERNEL_INSTALL_TARGET=y
BR2_LINUX_KERNEL_NEEDS_HOST_OPENSSL=y

# U-Boot 2025.04 with the Nova board patches (SD is 1-bit only on this board)
BR2_TARGET_UBOOT=y
BR2_TARGET_UBOOT_BUILD_SYSTEM_KCONFIG=y
BR2_TARGET_UBOOT_CUSTOM_VERSION=y
BR2_TARGET_UBOOT_CUSTOM_VERSION_VALUE="2025.04"
BR2_TARGET_UBOOT_PATCH="$(BR2_EXTERNAL_LUCKFOX_NOVA_PATH)/board/luckfox/nova/patches/uboot"
BR2_TARGET_UBOOT_BOARD_DEFCONFIG="luckfox-rk3308b-nova"
BR2_TARGET_UBOOT_CUSTOM_MAKEOPTS="BL31=$(BR2_EXTERNAL_LUCKFOX_NOVA_PATH)/board/luckfox/nova/rkbin/rk3308_bl31_v2.26.elf ROCKCHIP_TPL=$(BR2_EXTERNAL_LUCKFOX_NOVA_PATH)/board/luckfox/nova/rkbin/rk3308_ddr_589MHz_uart4_m0_v2.07.bin"
BR2_TARGET_UBOOT_NEEDS_DTC=y
BR2_TARGET_UBOOT_NEEDS_PYLIBFDT=y
BR2_TARGET_UBOOT_NEEDS_PYELFTOOLS=y
BR2_TARGET_UBOOT_NEEDS_OPENSSL=y
BR2_TARGET_UBOOT_FORMAT_CUSTOM=y
BR2_TARGET_UBOOT_FORMAT_CUSTOM_NAME="u-boot-rockchip.bin"

# Rootfs + image
BR2_TARGET_ROOTFS_EXT2=y
BR2_TARGET_ROOTFS_EXT2_4=y
BR2_TARGET_ROOTFS_EXT2_SIZE="512M"
BR2_PACKAGE_HOST_GENIMAGE=y
BR2_ROOTFS_POST_BUILD_SCRIPT="$(BR2_EXTERNAL_LUCKFOX_NOVA_PATH)/board/luckfox/nova/post-build.sh"
BR2_ROOTFS_POST_IMAGE_SCRIPT="$(BR2_EXTERNAL_LUCKFOX_NOVA_PATH)/board/luckfox/nova/post-image.sh"

# A few comforts
BR2_PACKAGE_DROPBEAR=y
BR2_PACKAGE_HTOP=y

# Entropy daemon: mainline has no RK3308 HW RNG and crng takes ~76s to init
BR2_PACKAGE_HAVEGED=y

# Ship the GPIO inspector (usr/sbin/gpiocheck)
BR2_ROOTFS_OVERLAY="$(BR2_EXTERNAL_LUCKFOX_NOVA_PATH)/board/luckfox/nova/rootfs-overlay"

# No autoboot countdown
BR2_TARGET_UBOOT_CONFIG_FRAGMENT_FILES="$(BR2_EXTERNAL_LUCKFOX_NOVA_PATH)/board/luckfox/nova/uboot.fragment"

# sftp server so modern scp (SFTP protocol) works against dropbear
BR2_PACKAGE_GESFTPSERVER=y
```

## package/aic8800dc/Config.in
```kconfig
config BR2_PACKAGE_AIC8800DC
	bool "aic8800dc (Nova W WiFi)"
	depends on BR2_LINUX_KERNEL
	select BR2_PACKAGE_WPA_SUPPLICANT
	select BR2_PACKAGE_WPA_SUPPLICANT_NL80211
	select BR2_PACKAGE_IW
	select BR2_PACKAGE_WIRELESS_REGDB
	help
	  Out-of-tree AICSemi AIC8800DC SDIO WiFi driver (fullmac) for the
	  Luckfox Nova W. Builds the aic_load_fw + aic8800_fdrv modules
	  flipped to SDIO, installs the DC firmware blobs, and loads the
	  modules at boot. Needs CONFIG_CFG80211 in the kernel and the
	  WiFi DTS nodes (W=1 build supplies both).

	  Source: https://github.com/crackerjacques/AIC8800DC
```
